## dts/bindings/lora/st,stm32wl-subghz-radio.yaml
```yaml
# Copyright (c) 2021 Fabio Baltieri
# SPDX-License-Identifier: Apache-2.0

description: STM32WL SUBGHZ Radio

compatible: "st,stm32wl-subghz-radio"

include: semtech,sx126x-base.yaml

properties:
    interrupts:
      required: true
      description: |
        Position of the "Radio IRQ, Busy" interrupt line.
    rfo-low-power:
      type: boolean
      required: false
      description: |
        Set to select low power radio output (RFO_LP pin) instead of
        high power (RFO_HP pin).

      
```
